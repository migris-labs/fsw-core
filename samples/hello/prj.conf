## CMakeLists.txt
```
# SPDX-License-Identifier: Apache-2.0 Copyright 2026 Migris Labs

cmake_minimum_required(VERSION 3.20.0)

find_package(Zephyr REQUIRED HINTS $ENV{ZEPHYR_BASE})
project(fsw_core_hello LANGUAGES C)

target_sources(app PRIVATE src/main.c)
```

## sample.yaml
```
sample:
  name: fsw-core hello-world
  description: >-
    Hello-world Zephyr app proving the fsw-core cross-compile toolchain
    end-to-end on the platform's pinned target (STM32H753ZI / Cortex-M7).
tests:
  sample.fsw-core.hello:
    platform_allow: nucleo_h753zi
    tags: introduction
    harness: console
    harness_config:
      type: one_line
      regex:
        - "Hello, fsw-core / nucleo_h753zi"
```

## prj.conf
```kconfig
# Minimum Zephyr application configuration for the fsw-core hello-world.
# Just enough to print to the UART console on boot; no logging backend,
# no networking, no shell. Slice fsw-2.

CONFIG_PRINTK=y
CONFIG_BOOT_BANNER=y
CONFIG_THREAD_NAME=y
CONFIG_LOG=n
```

## src/main.c
```c
/*
 * SPDX-License-Identifier: Apache-2.0
 * Copyright 2026 Migris Labs
 *
 * fsw-core hello-world — slice fsw-2.
 *
 * Minimum Zephyr application that proves the cross-compile toolchain
 * end-to-end on the platform's pinned target (STM32H753ZI / Cortex-M7
 * on the nucleo_h753zi board). The console string emitted here is the
 * contract a future Renode UART smoke test (slice fsw-3) will assert
 * on; see samples/hello/sample.yaml.
 */

#include <zephyr/kernel.h>
#include <zephyr/sys/printk.h>

int main(void) {
    printk("Hello, fsw-core / nucleo_h753zi\n");
    printk("boot ok; idling\n");

    while (1) {
        k_sleep(K_SECONDS(1));
    }
    return 0;
}
```
